## boards/arm/max32655/Kconfig.defconfig
```kconfig
# MAX32655FTHR/EVKIT boards configuration

# Copyright (c) 2023 Analog Devices, Inc.
# SPDX-License-Identifier: Apache-2.0

if BOARD_MAX32655FTHR || BOARD_MAX32655EVKIT

config BOARD
	default "max32655fthr" if BOARD_MAX32655FTHR
	default "max32655evkit" if BOARD_MAX32655EVKIT

endif # BOARD_MAX32655FTHR/EVKIT
```

## boards/arm/max32655evkit/Kconfig.board
```kconfig
# MAX32655FTHR/EVKIT boards configuration

# Copyright (c) 2023 Analog Devices, Inc.
# SPDX-License-Identifier: Apache-2.0

config BOARD_MAX32655EVKIT
	bool "MAX32655EVKIT"
	depends on SOC_MAX32655
```

## boards/arm/max32655evkit/Kconfig.defconfig
```kconfig
# MAX32655EVKIT boards configuration

# Copyright (c) 2023 Analog Devices, Inc.
# SPDX-License-Identifier: Apache-2.0

if BOARD_MAX32655EVKIT

config BOARD
	default "max32655evkit" if BOARD_MAX32655EVKIT

endif # BOARD_MAX32655EVKIT
```

## boards/arm/max32655fthr/Kconfig.board
```kconfig
# MAX32655FTHR boards configuration

# Copyright (c) 2023 Analog Devices, Inc.
# SPDX-License-Identifier: Apache-2.0

config BOARD_MAX32655FTHR
	bool "MAX32655FTHR"
	depends on SOC_MAX32655
```

## boards/arm/max32655fthr/Kconfig.defconfig
```kconfig
# MAX32655FTHR boards configuration

# Copyright (c) 2023 Analog Devices, Inc.
# SPDX-License-Identifier: Apache-2.0

if BOARD_MAX32655FTHR

config BOARD
	default "max32655fthr" if BOARD_MAX32655FTHR

endif # BOARD_MAX32655FTHR
```

## boards/arm/max32655fthr/max32655fthr_defconfig
```kconfig
# Copyright (c) 2023 Analog Devices, Inc.
# SPDX-License-Identifier: Apache-2.0

CONFIG_SOC_SERIES_MAX32=y
CONFIG_SOC_MAX32655=y

# Enable GPIO
CONFIG_GPIO=y

CONFIG_SYS_CLOCK_HW_CYCLES_PER_SEC=100000000
CONFIG_PINCTRL=y

# Console
CONFIG_CONSOLE=y
CONFIG_UART_CONSOLE=y

# enable uart driver
CONFIG_SERIAL=y
CONFIG_UART_INTERRUPT_DRIVEN=y

# Enable Clocks
CONFIG_CLOCK_CONTROL=y

# Enable RTC
CONFIG_RTC=y
```

## boards/arm/max32666fthr/Kconfig.board
```kconfig
# MAX32666FTHR boards configuration

# Copyright (c) 2023 Analog Devices, Inc.
# SPDX-License-Identifier: Apache-2.0

config BOARD_MAX32666FTHR
	bool "MAX32666FTHR"
	depends on SOC_MAX32666
```

## boards/arm/max32666fthr/Kconfig.defconfig
```kconfig
# MAX32666FTHR boards configuration

# Copyright (c) 2023 Analog Devices, Inc.
# SPDX-License-Identifier: Apache-2.0

if BOARD_MAX32666FTHR

config BOARD
	default "max32666fthr" if BOARD_MAX32666FTHR

endif # BOARD_MAX32666FTHR
```

## boards/arm/max32666fthr2/Kconfig.board
```kconfig
# MAX32666FTHR2 boards configuration

# Copyright (c) 2023 Analog Devices, Inc.
# SPDX-License-Identifier: Apache-2.0

config BOARD_MAX32666FTHR2
	bool "MAX32666FTHR2"
	depends on SOC_MAX32666
```

## boards/arm/max32666fthr2/Kconfig.defconfig
```kconfig
# MAX32666FTHR2 boards configuration

# Copyright (c) 2023 Analog Devices, Inc.
# SPDX-License-Identifier: Apache-2.0

if BOARD_MAX32666FTHR2

config BOARD
	default "max32666fthr2" if BOARD_MAX32666FTHR2

endif # BOARD_MAX32666FTHR2
```

## boards/arm/max32690evkit/Kconfig.board
```kconfig
# MAX32690 board configuration

# Copyright (c) 2023 Analog Devices, Inc.
# SPDX-License-Identifier: Apache-2.0

config BOARD_MAX32690EVKIT
	bool "MAX32690EVKIT"
	depends on SOC_MAX32690
```

## boards/arm/max32690evkit/Kconfig.defconfig
```kconfig
# MAX32690 board configuration

# Copyright (c) 2023 Analog Devices, Inc.
# SPDX-License-Identifier: Apache-2.0

if BOARD_MAX32690EVKIT

config BOARD    
    default "MAX32690EVKIT"

endif # BOARD_MAX32690EVKIT
```

## boards/arm/max32690evkit/max32690evkit_defconfig
```kconfig
# Copyright (c) 2023 Analog Devices, Inc.
# SPDX-License-Identifier: Apache-2.0

CONFIG_SOC_SERIES_MAX32=y
CONFIG_SOC_MAX32690=y

# Enable GPIO
CONFIG_GPIO=y

CONFIG_SYS_CLOCK_HW_CYCLES_PER_SEC=120000000

CONFIG_PINCTRL=y

# Console
CONFIG_CONSOLE=y
CONFIG_UART_CONSOLE=y

# Enable UART
CONFIG_SERIAL=y
CONFIG_UART_INTERRUPT_DRIVEN=y

# Enable Clocks
CONFIG_CLOCK_CONTROL=y

# Enable I2C
CONFIG_I2C=y

# Enable SPI
CONFIG_SPI=y

# Enable DMA
CONFIG_DMA=y

# Enable RTC
CONFIG_RTC=y
```

## drivers/adc/Kconfig.max32
```kconfig
# ADI SoC ADC configuration options

# Copyright (c) 2023 Analod Device, Inc.
# SPDX-License-Identifier: Apache-2.0

config ADC_MAX32
	bool "MAX32 ADC driver"
	default y
	help
	  Enable the driver implementation for the max32xx ADC
```

## drivers/clock_control/Kconfig.max32
```kconfig
# Copyright (c) 2023 Analog Devices, Inc.
# SPDX-License-Identifier: Apache-2.0

config CLOCK_CONTROL_MAX32
	bool "MAX32 Clock Control Driver"
	default y
	depends on SOC_FAMILY_ADI_MAX
	help
	  Enable clock control support for Analog Devices MAX32xxx/MAX78xxx SoC series.
```

## drivers/rtc/Kconfig.max32
```kconfig
# ADI SoC RTC configuration options

# Copyright (c) 2023 Analog Devices, Inc.
# SPDX-License-Identifier: Apache-2.0

config RTC_MAX32
	bool "RTC driver for x86 CMOS/RTC clock"
	default y
```

## drivers/timer/Kconfig.max32
```kconfig
# Copyright (c) 2023 Analog Devices, Inc.
# SPDX-License-Identifier: Apache-2.0

config MAX32_TIMER
	bool "MAX32 Timer"
	default y
	depends on DT_HAS_ADI_MAX32_TIMER_ENABLED
```

## dts/bindings/adc/adi,max32-adc.yaml
```yaml
# Copyright (c) 2023 Analog Devices, Inc.
# SPDX-License-Identifier: Apache-2.0

description: ADI MAX32 I2C

compatible: "adi,max32-adc"

include: [adc-controller.yaml]

properties:
  reg:
    required: true

  interrupts:
    required: true

  channel-count:
    type: int
    required: true
    description: The maximum channels supported on each unit.

  "#io-channel-cells":
    const: 1

io-channel-cells:
  - input
```

## dts/bindings/rng/adi,max32-trng.yaml
```yaml
# Copyright (c) 2023 Analog Devices, Inc.
# SPDX-License-Identifier: Apache-2.0

description: ADI MAX32XXX TRNG

compatible: "adi,max32-trng"

include: base.yaml

properties:
  reg:
    required: true
```

## dts/bindings/serial/adi,max32-uart.yaml
```yaml
# Copyright (c) 2023 Analog Devices, Inc.
# SPDX-License-Identifier: Apache-2.0

description: MAX32 UART

include: [uart-controller.yaml, pinctrl-device.yaml]

compatible: "adi,max32-uart"

properties:
    reg:
      required: true

    clocks:
      required: true

    interrupts:
      required: false

    pinctrl:
      type: phandles
      required: false

    clock-source:
      type: int
      default: 2
      description: |
        Clock source to be used by the UART peripheral. The following options
        are available:
        - 0: "ADI_MAX32_UART_CLK_PCLK" Peripheral clock
        - 1: "ADI_MAX32_UART_CLK_EXTCLK" External Clock
        - 2: "ADI_MAX32_UART_CLK_IBRO" Internal Baud Rate Oscillator
        - 3: "ADI_MAX32_UART_CLK_ERFO" External Radio Frequency Oscillator
        - 4: "ADI_MAX32_UART_CLK_ERTCO" External Real-Time Clock Oscillator
        - 5: "ADI_MAX32_UART_CLK_INRO" Internal Ring Oscillator
        The target device might not support all option please take a look on
        target device user guide

    data-bits:
      type: int
      default: 8
      description: Data bits. Can be set to 5, 6, 7 or 8.
```

## dts/bindings/spi/adi,max32-spi.yaml
```yaml
# Copyright (c) 2023 Analog Devices, Inc.
# SPDX-License-Identifier: Apache-2.0

description: ADI MAX32 SPI

include:
    - name: spi-controller.yaml
    - name: pinctrl-device.yaml

compatible: "adi,max32-spi"

properties:
    reg:
        required: true

    pinctrl-0:
      type: phandles
      required: true
```

## dts/bindings/timer/adi,max32-timer.yaml
```yaml
# Copyright (c) 2023 Analog Devices, Inc.
# SPDX-License-Identifier: Apache-2.0

description: ADI MAX32 timer

compatible: "adi,max32-timer"

include: [base.yaml, reset-device.yaml]

properties:
  reg:
    required: true
```

## dts/bindings/watchdog/adi,max32-watchdog.yaml
```yaml
# Copyright (c) 2023 Analog Devices, Inc.
# SPDX-License-Identifier: Apache-2.0

description: MAX32XXX watchdog

compatible: "adi,max32-watchdog"

include: base.yaml

properties:
  reg:
    required: true
```

## soc/arm/adi/max32/Kconfig.defconfig.max32690
```kconfig
# Analog Devices MAX32690 MCU

# Copyright (c) 2023 Analog Devices, Inc.
# SPDX-License-Identifier: Apache-2.0

if SOC_MAX32690

config SOC
	default "max32690"

config NUM_IRQS
	default 127

endif # SOC_MAX32690
```

## soc/arm/adi_max/Kconfig
```kconfig
# Analog Devices MAX32xxx/MAX78xxx MCU series

# Copyright (c) 2023 Analog Devices, Inc.
# SPDX-License-Identifier: Apache-2.0

config SOC_FAMILY_ADI_MAX
	bool "Select ADI family"

if SOC_FAMILY_ADI_MAX

config SOC_FAMILY
	string
	default "adi_max"

source "soc/arm/adi_max/*/Kconfig.soc"

endif # SOC_FAMILY_ADI_MAX
```
