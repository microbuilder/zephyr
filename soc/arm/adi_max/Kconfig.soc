## soc/arm/adi_max/Kconfig.soc
```kconfig
# Copyright (c) 2023 Analog Devices, Inc.
# SPDX-License-Identifier: Apache-2.0

source "soc/arm/adi_max/*/Kconfig.series"
```

## soc/arm/adi_max/max32/Kconfig.defconfig.max32655
```kconfig
# Analog Devices MAX32655 MCU

# Copyright (c) 2023 Analog Devices, Inc.
# SPDX-License-Identifier: Apache-2.0

if SOC_MAX32655

config SOC
	default "max32655"

config NUM_IRQS
	default 125

config SERIAL_SUPPORT_INTERRUPT
	bool
	default n

endif # SOC_MAX32655
```

## soc/arm/adi_max/max32/Kconfig.series
```kconfig
# Analog Devices MAX32xxx MCU series

# Copyright (c) 2023 Analog Devices, Inc.
# SPDX-License-Identifier: Apache-2.0

config SOC_SERIES_MAX32
	bool "MAX32XXX Series MCU"
	select ARM
	select CPU_CORTEX_M4
	select CPU_CORTEX_M_HAS_SYSTICK
	select SOC_FAMILY_ADI_MAX
	help
	  Enable support for MAX32xxx MCU series
```

## soc/arm/adi_max/max32/Kconfig.soc
```kconfig
# Analog Devices MAX32xxx MCU series

# Copyright (c) 2023 Analog Devices, Inc.
# SPDX-License-Identifier: Apache-2.0

choice
	prompt "MAX32XXX MCU Selection"
	depends on SOC_SERIES_MAX32

config SOC_MAX32655
	bool "MAX32655"

endchoice
```

## subsys/instrumentation/Kconfig
```kconfig
# Copyright (c) 2022 Linaro
# SPDX-License-Identifier: Apache-2.0

# Instrumentation configuration options

config INSTRUMENTATION
	bool "Compiler Instrumentation Support"
	imply THREAD_NAME
	imply THREAD_STACK_INFO
	imply THREAD_MONITOR
	help
	  Enable compiler-managed runtime system instrumentation. This requires a
	  compiler that supports function instrumentation, and a backend for
	  capturing and processing those instrumentation events in the running
	  application.

if INSTRUMENTATION

choice
	prompt "Instrumentation Mode"
	default INSTRUMENTATION_MODE_CALLGRAPH

config INSTRUMENTATION_MODE_CALLGRAPH
	bool "Enable call graph reconstruction (tracing)"
	select THREAD_NAME
	select INIT_STACKS
	select THREAD_MONITOR
	help
	  Enables reconstruction of an instrumented call graph of function
	  entry and exit events, within the limits of allocated memory.

config INSTRUMENTATION_MODE_STATISTICAL
	bool "Enable statistical profiling"
	help
	  Enables statistical profiling of the runtime system, tracking total
	  execution time of the number of functions equal to TBD_VARIABLE.

endchoice

menu "Instrumentation Configuration"

config INSTRUMENTATION_BUFFER_SIZE
	int "Size of instrumentation buffer"
	default 8192 if INSTRUMENTATION_MODE_CALLGRAPH
	default 2048 if INSTRUMENTATION_MODE_STATISTICAL
	range 32 65536
	help
	  Size of instrumentation buffer. If INSTRUMENTATION_MODE_CALLGRAPH is
	  enabled, instrumentation buffer is used as a ring buffer to buffer entry
	  and exit event packets. If INSTRUMENTATION_MODE_STATISTICAL is enabled,
	  each function encountered is added to the buffer for tracking until the
	  buffer is full, at which point new functions will be ignored.

endmenu  # Instrumentation Configuration

endif
```
