## CMakeLists.txt
```
#
# Copyright (c) 2021-2022 Linaro Limited
#
# SPDX-License-Identifier: Apache-2.0
#

cmake_minimum_required(VERSION 3.13.1)

find_package(Zephyr REQUIRED HINTS $ENV{ZEPHYR_BASE})

get_target_property(TFM_BINARY_DIR tfm TFM_BINARY_DIR)
configure_file(
  ${CMAKE_CURRENT_LIST_DIR}/tfm_secure_inference_partitions/tfm_manifest_list.yaml.in
  ${CMAKE_CURRENT_BINARY_DIR}/tfm_secure_inference_partitions/tfm_manifest_list.yaml
)

set_property(TARGET zephyr_property_target
  APPEND PROPERTY TFM_CMAKE_OPTIONS
  -DTFM_EXTRA_MANIFEST_LIST_FILES=${CMAKE_CURRENT_BINARY_DIR}/tfm_secure_inference_partitions/tfm_manifest_list.yaml
  -DTFM_EXTRA_PARTITION_PATHS="${CMAKE_CURRENT_LIST_DIR}/tfm_secure_inference_partitions/tfm_huk_key_derivation_service\\\;${CMAKE_CURRENT_LIST_DIR}/tfm_secure_inference_partitions/tfm_tflm_service"
  )

# set_property(TARGET zephyr_property_target
#   APPEND_STRING PROPERTY TFM_PARTITION_PATHS
#   ${PARTITION_PATHS}
#   )

project(tfm_secure_provisioning)

target_sources(app PRIVATE
  src/main.c
  src/pk_import_verify_sign.c
  src/cose_verify.c
  src/tfm_secure_infer_partitions_service_api.c
  src/util_app_log.c
  src/util_sformat.c
  ext/NanoCBOR/src/decoder.c
  ext/NanoCBOR/src/encoder.c
)

target_include_directories(app PRIVATE
  ${ZEPHYR_TRUSTED_FIRMWARE_M_MODULE_DIR}/interface/include
  ext/NanoCBOR/include
)

target_compile_definitions(app PRIVATE
  TFM_PARTITION_HUK_KEY_DERIVATION
  TFM_PARTITION_TFLM_SERVICE
  NANOCBOR_BYTEORDER_HEADER=<sys/byteorder.h>
  NANOCBOR_BE64TOH_FUNC=sys_be64_to_cpu
  NANOCBOR_HTOBE64_FUNC=sys_cpu_to_be64
  NANOCBOR_HTOBE32_FUNC=sys_cpu_to_be32
)

# In TF-M, default value of CRYPTO_ENGINE_BUF_SIZE is 0x2080. It causes
# insufficient memory failure while verifying signature. Increase it to 0x2400.
set_property(TARGET zephyr_property_target
             APPEND PROPERTY TFM_CMAKE_OPTIONS
             -DCRYPTO_ENGINE_BUF_SIZE=0x2400
)

zephyr_include_directories(${APPLICATION_SOURCE_DIR}/src/tls_config)
```

## Kconfig
```
# Private config options for TF-M secure provisioning application

# Copyright (c) 2021 Linaro
# SPDX-License-Identifier: Apache-2.0

mainmenu "TF-M secure inference sample application"

menu "Application configuration"

module = PSA
module-str = psa
source "subsys/logging/Kconfig.template.log_config"

endmenu

source "Kconfig.zephyr"
```

## prj.conf
```kconfig
#
# Copyright (c) 2021-2022 Linaro Limited
#
# SPDX-License-Identifier: Apache-2.0
#

CONFIG_LOG=y
CONFIG_LOG_MODE_IMMEDIATE=y
CONFIG_LOG_RUNTIME_FILTERING=y
CONFIG_LOG_DEFAULT_LEVEL=4

CONFIG_BUILD_WITH_TFM=y
CONFIG_TFM_IPC=y

# Enable TF-M debug build
# CONFIG_TFM_CMAKE_BUILD_TYPE_DEBUG=y

# The Zephyr CMSIS emulation assumes that ticks are ms, currently
CONFIG_SYS_CLOCK_TICKS_PER_SEC=1000

CONFIG_MAIN_STACK_SIZE=8192
CONFIG_HEAP_MEM_POOL_SIZE=4096

# Enable floating point print in Zephyr
CONFIG_NEWLIB_LIBC=y
CONFIG_NEWLIB_LIBC_FLOAT_PRINTF=y
CONFIG_CBPRINTF_FP_SUPPORT=y

# Mbed TLS
CONFIG_MBEDTLS=y
CONFIG_MBEDTLS_BUILTIN=y
CONFIG_MBEDTLS_ENABLE_HEAP=y
CONFIG_MBEDTLS_HEAP_SIZE=32768
CONFIG_MBEDTLS_USER_CONFIG_ENABLE=y
CONFIG_MBEDTLS_USER_CONFIG_FILE="user-tls.conf"
```

## src/main.c
```c
/*
 * Copyright (c) 2021-2022 Linaro Limited
 *
 * SPDX-License-Identifier: Apache-2.0
 */

#include <stdio.h>

#include <zephyr.h>
#include <logging/log_ctrl.h>
#include <logging/log.h>

#include <tfm_veneers.h>
#include <tfm_ns_interface.h>
#include "tfm_secure_infer_partitions_service_api.h"
#include "cose_verify.h"
#include "util_app_log.h"
#include "util_sformat.h"
#include "pk_import_verify_sign.h"
#include <math.h>

/** Declare a reference to the application logging interface. */
LOG_MODULE_DECLARE(app, CONFIG_LOG_DEFAULT_LEVEL);

int tflm_inference_value_decode_and_verify_sign(uint8_t *inf_val_encoded_buf,
						size_t inf_val_encoded_buf_len,
						const unsigned char *pkey,
						float *y_val)
{
	uint8_t *dec;
	size_t len_dec;
	cose_sign_context_t ctx;
	int status;

	status = mbedtls_ecp_load_representation(&ctx.pk,
						 pkey,
						 strlen(pkey));
	if (status != 0) {
		LOG_ERR("Load the public key failed\n");
		goto err;
	}

	status = cose_sign_init(&ctx);
	if (status != COSE_ERROR_NONE) {
		LOG_ERR("Failed to initialize COSE signing context.\n");
		goto err;
	}

	status = cose_verify_sign1(&ctx,
				   inf_val_encoded_buf,
				   inf_val_encoded_buf_len,
				   (const uint8_t **) &dec,
				   &len_dec);
	if (status != COSE_ERROR_NONE) {
		LOG_ERR("Failed to authenticate signature.\n");
		goto err;
	}

	status = cose_payload_decode(dec, len_dec, y_val);
	if (status != COSE_ERROR_NONE) {
		LOG_ERR("Failed to authenticate signature.\n");
		goto err;
	}
	return status;
err:
	al_dump_log();
	cose_sign_free(&ctx);
	return status;
}

void main(void)
{
	psa_status_t status;

	const float PI = 3.14159265359f;
	float deg = PI / 180.0;

	psa_key_id_t key_id = C_SIGN; // Using Device COSE SIGN key
	uint8_t inf_val_encoded_buf[256];
	size_t inf_val_encoded_buf_len = 0;
	uint8_t public_key[65] = { 0 }; /* EC public key = 65 bytes. */
	size_t public_key_len = sizeof(public_key);
	float x_value, y_value;

	/* Initialise the logger subsys and dump the current buffer. */
	log_init();

	unsigned char uuid[37];
	/* String format output config. */
	struct sf_hex_tbl_fmt fmt = {
		.ascii = true,
		.addr_label = true,
		.addr = 0
	};
	// Generate UUID
	status = al_psa_status(
		psa_huk_key_derivation_generate_uuid(uuid, sizeof(uuid)),
		__func__);
	if (status != PSA_SUCCESS) {
		LOG_ERR("Unable to get UUID.");
		return;
	}
	LOG_INF("Generated UUID: %s", uuid);

	status = al_psa_status(
		psa_huk_key_derivation_export_public_key(&key_id,
							 public_key,
							 public_key_len),
		__func__);
	if (status != PSA_SUCCESS) {
		LOG_ERR("Failed to export the_public_key");
		goto err;
	}

	for (int i = 1; i <= 20; i++) {

		x_value = (float)i * deg;
		status = al_psa_status(
			psa_secure_inference_tflm_hello(&key_id,
							&x_value,
							sizeof(x_value),
							inf_val_encoded_buf,
							sizeof(inf_val_encoded_buf),
							&inf_val_encoded_buf_len),
			__func__);

		if (status != PSA_SUCCESS) {
			LOG_ERR("Failed to get sine value using secure inference");
			goto err;
		}

		LOG_INF("CBOR encoded and COSE signed inference value:");
		sf_hex_tabulate_16(&fmt, inf_val_encoded_buf, inf_val_encoded_buf_len);

		if (tflm_inference_value_decode_and_verify_sign(
			    &inf_val_encoded_buf[0],
			    inf_val_encoded_buf_len,
			    public_key,
			    &y_value) != 0) {
			LOG_ERR("NS: Failed to verify signature.\n");
		} else {
			LOG_INF("NS: Verified the signature using the public key.\n");
		}


		printf("Model: Sine of %d deg is: %f\t", i, y_value);
		printf("C Mathlib: Sine of %d deg is: %f\t", i, sin(x_value));
		printf("Deviation: %f\n", fabs(sin(x_value) - y_value));
		al_dump_log();

		k_msleep(500);
	}

err:
	/* Dump any queued log messages, and wait for system events. */
	al_dump_log();
}
```

## src/cose_verify.c
```c
/*
 * Copyright (c) 2022 Linaro Limited
 *
 * SPDX-License-Identifier: Apache-2.0
 */
#include "cose_verify.h"
#include "pk_import_verify_sign.h"

#define HASH_TSTR(md_ctx, nc, buf, len_buf, str)		    \
	nanocbor_encoder_init(&nc, buf, len_buf);		    \
	nanocbor_fmt_tstr(&nc, strlen(str));			    \
	mbedtls_md_update(&md_ctx, buf, nanocbor_encoded_len(&nc)); \
	mbedtls_md_update(&md_ctx, str, strlen(str));

#define HASH_BSTR(md_ctx, nc, buf, len_buf, bstr, len_bstr)	    \
	nanocbor_encoder_init(&nc, buf, len_buf);		    \
	nanocbor_fmt_bstr(&nc, len_bstr);			    \
	mbedtls_md_update(&md_ctx, buf, nanocbor_encoded_len(&nc)); \
	mbedtls_md_update(&md_ctx, bstr, len_bstr);

static int cose_encode_prot(nanocbor_encoder_t *nc)
{
	nanocbor_fmt_map(nc, 1);
	nanocbor_fmt_int(nc, cose_header_algorithm);
	nanocbor_fmt_int(nc, COSE_ALG_ECDSA_SHA256);
	return nanocbor_encoded_len(nc);
}

int cose_sign_init(cose_sign_context_t *ctx)
{
	mbedtls_ecp_group_id grp_id =
		mbedtls_pk_ec(ctx->pk)->MBEDTLS_PRIVATE(grp).id;

	if (grp_id == MBEDTLS_ECP_DP_SECP256R1) {
		ctx->len_hash = 32;
		ctx->len_sig = 72;
	} else {
		return COSE_ERROR_UNSUPPORTED;
	}

	return COSE_ERROR_NONE;
}

int cose_sign1_hash(cose_sign_context_t *ctx,
		    const uint8_t *pld,
		    const size_t len_pld,
		    uint8_t *hash)
{
	mbedtls_md_context_t md_ctx;

	mbedtls_md_setup(&md_ctx,
			 mbedtls_md_info_from_type(MBEDTLS_MD_SHA256),
			 0);
	mbedtls_md_starts(&md_ctx);
	nanocbor_encoder_t nc;

	/* serialize body_protected */
	nanocbor_encoder_init(&nc, NULL, 0);
	size_t len_prot = cose_encode_prot(&nc);
	uint8_t prot[len_prot];
	nanocbor_encoder_init(&nc, prot, len_prot);
	cose_encode_prot(&nc);

	/* serialize and hash ToBeSigned */
	size_t len_buf = 8;
	uint8_t buf[len_buf];

	nanocbor_encoder_init(&nc, buf, len_buf);
	nanocbor_fmt_array(&nc, 4);
	mbedtls_md_update(&md_ctx, buf, nanocbor_encoded_len(&nc));

	HASH_TSTR(md_ctx, nc, buf, len_buf, COSE_CONTEXT_SIGN1)
	HASH_BSTR(md_ctx, nc, buf, len_buf, prot, len_prot)
	/* external_aad. There is none so an empty bstr */
	HASH_BSTR(md_ctx, nc, buf, len_buf, NULL, 0)
	HASH_BSTR(md_ctx, nc, buf, len_buf, pld, len_pld)

	if (mbedtls_md_finish(&md_ctx, hash)) {
		return COSE_ERROR_HASH;
	}
	return COSE_ERROR_NONE;
}


int cose_sign1_decode(cose_sign_context_t *ctx,
		      const uint8_t *obj, const size_t len_obj,
		      const uint8_t **pld, size_t *len_pld,
		      const uint8_t **sig, size_t *len_sig,
		      uint8_t *hash)
{
	nanocbor_value_t nc, arr;

	nanocbor_decoder_init(&nc, obj, len_obj);
	nanocbor_skip(&nc);

	if (nanocbor_enter_array(&nc, &arr) < 0) {
		return COSE_ERROR_DECODE;
	}

	nanocbor_skip(&arr);
	nanocbor_skip(&arr);
	nanocbor_get_bstr(&arr, pld, len_pld);

	cose_sign1_hash(ctx, *pld, *len_pld, hash);

	nanocbor_get_bstr(&arr, sig, len_sig);
	return COSE_ERROR_NONE;
}

int cose_payload_decode(const uint8_t *obj,
			const size_t len_obj,
			float *inf_sig_value)
{
	nanocbor_value_t nc, arr;
	size_t pld_len = sizeof(float);
	uint8_t temp = 0;
	uint8_t *sig = &temp;

	nanocbor_decoder_init(&nc, obj, len_obj);

	if (nanocbor_enter_map(&nc, &arr) < 0) {
		return COSE_ERROR_DECODE;
	}

	nanocbor_skip(&arr);
	nanocbor_get_bstr(&arr, (const uint8_t **)&sig, &pld_len);
	*inf_sig_value = *(float *)sig;
	return COSE_ERROR_NONE;
}

int cose_verify_sign1(cose_sign_context_t *ctx,
		      const uint8_t *obj,
		      const size_t len_obj,
		      const uint8_t **pld,
		      size_t *len_pld)
{
	uint8_t hash[ctx->len_hash];
	uint8_t *sig;
	size_t len_sig;

	if (cose_sign1_decode(ctx,
			      obj, len_obj,
			      pld, len_pld,
			      (const uint8_t **) &sig,
			      &len_sig, hash)) {
		return COSE_ERROR_DECODE;
	}

	if (mbedtls_ecdsa_pk_verify(
		    ctx->pk,
		    hash, ctx->len_hash, sig, len_sig) != 0) {
		return COSE_ERROR_AUTHENTICATE;
	}

	return COSE_ERROR_NONE;
}

void cose_sign_free(cose_sign_context_t *ctx)
{
	mbedtls_pk_free(&ctx->pk);
}
```

## src/cose_verify.h
```c
/*
 * Copyright (c) 2022 Linaro Limited
 *
 * SPDX-License-Identifier: Apache-2.0
 */

#ifndef COSE_VERIFY_H
#define COSE_VERIFY_H

#include <zephyr.h>
#include <string.h>
#include "nanocbor/nanocbor.h"

#ifndef CONFIG_MBEDTLS_CFG_FILE
#include "mbedtls/config-tls-generic.h"
#else
#include CONFIG_MBEDTLS_CFG_FILE
#endif

#include <mbedtls/md.h>
#include <mbedtls/pk.h>
#include <mbedtls/gcm.h>
#include <mbedtls/ecp.h>
#include <mbedtls/ecdsa.h>
#include <mbedtls/error.h>

#define COSE_ALG_ECDSA_SHA256 -7
#define COSE_CONTEXT_SIGN1 "Signature1"

#define COSE_ERROR_NONE                 0x00
#define COSE_ERROR_UNSUPPORTED          0x01
#define COSE_ERROR_DECODE               0x02
#define COSE_ERROR_AUTHENTICATE         0x03
#define COSE_ERROR_HASH                 0x04

typedef enum {
	cose_header_algorithm           = 1,
	cose_header_critical            = 2,
	cose_header_content_type        = 3,
	cose_header_kid                 = 4,
	cose_header_iv                  = 5,
	cose_header_partial_iv          = 6,
	cose_header_countersign         = 7,
	cose_header_operation_time      = 8,
	cose_header_countersign0        = 9,
	cose_header_hkdf_salt           = -20,
	cose_header_kdf_u_name          = -21,
	cose_header_kdf_u_nonce         = -22,
	cose_header_kdf_u_other         = -23,
	cose_header_kdf_v_name          = -24,
	cose_header_kdf_v_nonce         = -25,
	cose_header_kdf_v_other         = -26,
	cose_header_ecdh_ephemeral      = -1,
	cose_header_ecdh_static         = -2,
	cose_header_ecdh_epk            = -1,
	cose_header_ecdh_spk            = -2,
	cose_header_ecdh_spk_kid        = -3,
} cose_header_t;

typedef struct {
	/* internal */
	size_t len_sig;
	size_t len_hash;
	mbedtls_pk_context pk;
} cose_sign_context_t;

typedef enum {
	CLIENT_TLS      = 0x5001,  // Client TLS key id
	C_SIGN          = 0x5002,  // COSE SIGN key id
	C_ENCRYPT       = 0x5003,  // COSE ENCRYPT key id
} key_type_t;

/**
 * @brief Initialize COSE signing context
 *
 * @param       ctx     Pointer to uninitialized signing context
 * @param       mode    0 for signature generation, 1 for verification
 * @param       pem     PEM-formatted key string
 *
 * @return COSE_ERROR_NONE              Success
 *         COSE_ERROR_UNSUPPORTED       Crypto algorithm not supported
 */
int cose_sign_init(cose_sign_context_t *ctx);

/* free underlying mbedTLS contexts */
void cose_sign_free(cose_sign_context_t *ctx);

/**
 * @brief Decode a COSE object and verify the signature
 *
 * @param       ctx     Pointer to the COSE signing context
 * @param       obj     Pointer to the encoded COSE object
 * @param       len_obj Length of encode COSE object
 * @param[out]  pld     Pointer to payload within COSE object
 * @param[out]  len_pld Payload length
 *
 * @return COSE_ERROR_NONE              Success
 *         COSE_ERROR_DECODE            Failed to decode COSE object
 *         COSE_ERROR_HASH              Failed to hash authenticated data
 *         COSE_ERROR_AUTHENTICATE      Failed to authenticate signature
 */
int cose_verify_sign1(cose_sign_context_t *ctx,
		      const uint8_t *obj,
		      const size_t len_obj,
		      const uint8_t **pld,
		      size_t *len_pld);

/**
 * @brief Retrieve the inference value from a COSE encoded payload
 *
 * @param       obj            Pointer to the encoded COSE encoded payload
 *                             object
 * @param       len_obj        Length of encode COSE object
 * @param[out]  inf_sig_value  Pointer to the inference value extracted from
 *                             the encoded payload
 *
 * @return COSE_ERROR_NONE     Success
 *         COSE_ERROR_DECODE   Failed to decode COSE object
 */
int cose_payload_decode(const uint8_t *obj,
			const size_t len_obj,
			float *inf_sig_value);

#endif /* COSE_VERIFY_H */
```

## src/pk_import_verify_sign.c
```c
/*
 * Copyright (c) 2022 Linaro Limited
 *
 * SPDX-License-Identifier: Apache-2.0
 */
#include <logging/log_ctrl.h>
#include <logging/log.h>
#include "pk_import_verify_sign.h"
#include "util_app_log.h"

/** Declare a reference to the application logging interface. */
LOG_MODULE_DECLARE(app, CONFIG_LOG_DEFAULT_LEVEL);

int mbedtls_ecp_load_representation(mbedtls_pk_context *ctx,
				    const uint8_t *data,
				    size_t data_length)
{
	size_t curve_bytes = data_length;
	const mbedtls_pk_info_t *pk_info;
	size_t curve_bits;
	int status = MBEDTLS_ERR_ERROR_CORRUPTION_DETECTED;

	/* A Weierstrass public key is represented as:
	 * - The byte 0x04;
	 * - `x_P` as a `ceiling(m/8)`-byte string, big-endian;
	 * - `y_P` as a `ceiling(m/8)`-byte string, big-endian.
	 * So its data length is 2m+1 where m is the curve size in bits.
	 */
	if ((data_length & 1) == 0) {
		LOG_ERR("Invalid public key len.\n");
		goto err;
	}
	curve_bytes = data_length / 2;
	mbedtls_pk_init(ctx);
	/* We need to infer the bit-size from the data. Since the only
	* information we have is the length in bytes, the value of curve_bits
	* at this stage is rounded up to the nearest multiple of 8. */
	curve_bits = (curve_bytes * 8);
	pk_info = mbedtls_pk_info_from_type(MBEDTLS_PK_ECKEY);
	if (pk_info == NULL) {
		LOG_ERR("Invalid public key type.\n");
		status = MBEDTLS_ERR_PK_TYPE_MISMATCH;
		goto err;
	}
	status = mbedtls_pk_setup(ctx, pk_info);
	if (status != 0) {
		LOG_ERR("Public key config failed.\n");
		goto err;
	}

	/* Load the group. */
	status = mbedtls_ecp_group_load(
		&mbedtls_pk_ec(*ctx)->MBEDTLS_PRIVATE(grp),
		MBEDTLS_ECP_DP_SECP256R1);
	if (status != 0) {
		LOG_ERR("ECP group load failed.\n");
		goto err;
	}


	/* Load the public key value. */
	status = mbedtls_ecp_point_read_binary(
		&mbedtls_pk_ec(*ctx)->MBEDTLS_PRIVATE(grp),
		&mbedtls_pk_ec(*ctx)->MBEDTLS_PRIVATE(Q),
		data,
		data_length);
	if (status != 0) {
		LOG_ERR("The public key (format + X + Y) read failed.\n");
		goto err;
	}

	/* Check that the point is on the curve. */
	status = mbedtls_ecp_check_pubkey(
		&mbedtls_pk_ec(*ctx)->MBEDTLS_PRIVATE(grp),
		&mbedtls_pk_ec(*ctx)->MBEDTLS_PRIVATE(Q));
	if (status != 0) {
		LOG_ERR("Verifying the previous step of the loaded public key check failed.\n");
		goto err;
	}

	return status;
err:
	al_dump_log();
	return status;
}

/*
 * Verify a signature
 */
int mbedtls_ecdsa_pk_verify(mbedtls_pk_context ctx,
			    const unsigned char *hash,
			    size_t hash_len,
			    const unsigned char *sig,
			    size_t sig_len)
{
	mbedtls_mpi r;
	mbedtls_mpi s;

	mbedtls_mpi_init(&r);
	mbedtls_mpi_init(&s);
	int status = MBEDTLS_ERR_ERROR_CORRUPTION_DETECTED;
	if (mbedtls_mpi_read_binary(&r, sig, sig_len / 2) ||
	    mbedtls_mpi_read_binary(&s, &sig[sig_len / 2], sig_len / 2)) {
		LOG_ERR("Failed to the read signature.\n");
		status = MBEDTLS_ERR_MPI_ALLOC_FAILED;
		goto err;
	}
	status = mbedtls_ecdsa_verify(&mbedtls_pk_ec(ctx)->MBEDTLS_PRIVATE(grp),
				      hash, hash_len,
				      &mbedtls_pk_ec(ctx)->MBEDTLS_PRIVATE(Q), &r,
				      &s);
	if (status != 0) {
		LOG_ERR("Signature verification failed.\n");
		goto err;
	}
	return status;
err:
	al_dump_log();
	mbedtls_mpi_free(&r);
	mbedtls_mpi_free(&s);
	return status;
}
```

## src/pk_import_verify_sign.h
```c
/*
 * Copyright (c) 2022 Linaro Limited
 *
 * SPDX-License-Identifier: Apache-2.0
 */
#ifndef PK_IMPORT_VERIFY_SIGN_H
#define PK_IMPORT_VERIFY_SIGN_H

#include <stdio.h>
#include "mbedtls/pk.h"
#include "mbedtls/error.h"
#include <zephyr.h>

/**
 * @brief              Load the contents of a public key buffer
 *                     into an internal ECP representation.
 *
 * @note               This function does the pk setup, group load
 *                     (mbedtls_ecp_group_load()) ecp point read binary.
 *
 * @param ctx          Pointer to the uninitialized public-key context
 * @param data         The buffer from which to load the representation.
 * @param data_length  The size in bytes of \p data.
 *
 * @return Returns error code as specified in \ref MbedTLS error code.
 */
int mbedtls_ecp_load_representation(mbedtls_pk_context *ctx,
				    const uint8_t *data,
				    size_t data_length);

/**
 * \brief           Verify signature in non-ASN container format signed
 *                  payload.
 *
 * \param ctx       The PK context to use. It must have been set up.
 * \param hash      Hash of the message to sign
 * \param hash_len  Hash length
 * \param sig       Signature to verify
 * \param sig_len   Signature length
 *
 * \return          0 on success (signature is valid),
 *                  #MBEDTLS_ERR_PK_SIG_LEN_MISMATCH if there is a valid
 *                  signature in sig but its length is less than \p siglen,
 *                  or a specific error code.
 */
int mbedtls_ecdsa_pk_verify(mbedtls_pk_context ctx,
			    const unsigned char *hash,
			    size_t hash_len,
			    const unsigned char *sig,
			    size_t sig_len);
#endif /* PK_IMPORT_VERIFY_SIGN_H */
```

## src/tfm_secure_infer_partitions_service_api.c
```c
/*
 * Copyright (c) 2021-2022 Linaro Limited
 *
 * SPDX-License-Identifier: Apache-2.0
 */

#include "tfm_secure_infer_partitions_service_api.h"

#include "psa/client.h"
#include "psa_manifest/sid.h"

// psa_status_t example_read_lsm303(uint8_t *data,
//                               size_t data_size)
// {
//      psa_status_t status;
//      psa_handle_t handle;

//      psa_outvec out_vec[] = {
//              { .base = data, .len = data_size },
//      };

//      handle = psa_connect(TFM_EXAMPLE_READ_LSM303_SID, TFM_EXAMPLE_READ_LSM303_VERSION);
//      if (!PSA_HANDLE_IS_VALID(handle)) {
//              return PSA_HANDLE_TO_ERROR(handle);
//      }

//      status = psa_call(handle, PSA_IPC_CALL, NULL, 0, out_vec, 1);

//      psa_close(handle);

//      return status;
// }

psa_status_t psa_secure_inference_tflm_hello(psa_key_id_t *key_id,
					     const float *input,
					     size_t input_length,
					     uint8_t *encoded_buf,
					     size_t encoded_buf_size,
					     size_t *encoded_buf_len)
{
	psa_status_t status;
	psa_handle_t handle;
	psa_invec in_vec[] = {
		{ .base = key_id, .len = sizeof(psa_key_id_t) },
		{ .base = input, .len = input_length },
	};

	psa_outvec out_vec[] = {
		{ .base = encoded_buf, .len = encoded_buf_size },
		{ .base = encoded_buf_len, .len = sizeof(size_t) },
	};

	handle = psa_connect(TFM_TFLM_SERVICE_HELLO_SID,
			     TFM_TFLM_SERVICE_HELLO_VERSION);
	if (!PSA_HANDLE_IS_VALID(handle)) {
		return PSA_HANDLE_TO_ERROR(handle);
	}

	status = psa_call(handle,
			  PSA_IPC_CALL,
			  in_vec,
			  IOVEC_LEN(in_vec),
			  out_vec,
			  IOVEC_LEN(out_vec));

	psa_close(handle);

	return status;
}

psa_status_t psa_huk_key_derivation_export_public_key(psa_key_id_t *key_id,
						      uint8_t *ec_public_key_data,
						      size_t ec_public_key_data_size)
{
	psa_status_t status;
	psa_handle_t handle;

	psa_invec in_vec[] = {
		{ .base = key_id, .len = sizeof(psa_key_id_t) },
	};

	psa_outvec out_vec[] = {
		{ .base = ec_public_key_data, .len = ec_public_key_data_size },
	};

	handle = psa_connect(TFM_HUK_KEY_DERIVATION_EXPORT_PUBLIC_KEY_SID,
			     TFM_HUK_KEY_DERIVATION_EXPORT_PUBLIC_KEY_VERSION);
	if (!PSA_HANDLE_IS_VALID(handle)) {
		return PSA_ERROR_GENERIC_ERROR;
	}

	status = psa_call(handle,
			  PSA_IPC_CALL,
			  in_vec,
			  IOVEC_LEN(in_vec),
			  out_vec,
			  IOVEC_LEN(out_vec));

	psa_close(handle);

	return status;
}

psa_status_t psa_huk_key_derivation_generate_uuid(void *uuid,
						  size_t uuid_size)
{
	psa_status_t status;
	psa_handle_t handle;

	psa_outvec out_vec[] = {
		{ .base = uuid, .len = uuid_size }
	};

	handle = psa_connect(TFM_HUK_KEY_DERIVATION_GENERATE_UUID_SID,
			     TFM_HUK_KEY_DERIVATION_GENERATE_UUID_VERSION);
	if (!PSA_HANDLE_IS_VALID(handle)) {
		return PSA_ERROR_GENERIC_ERROR;
	}

	status = psa_call(handle,
			  PSA_IPC_CALL,
			  NULL,
			  0,
			  out_vec,
			  IOVEC_LEN(out_vec));

	psa_close(handle);

	return status;
}
```

## src/tfm_secure_infer_partitions_service_api.h
```c
/*
 * Copyright (c) 2021-2022 Linaro Limited
 *
 * SPDX-License-Identifier: Apache-2.0
 */
#ifndef __TFM_SECURE_INFER_PARTITIONS_SERVICE_API_H__
#define __TFM_SECURE_INFER_PARTITIONS_SERVICE_API_H__

#include <stdint.h>
#include <stddef.h>

#include "psa/error.h"
#include "psa/crypto.h"
#ifdef __cplusplus
extern "C" {
#endif

// /**
//  * \brief Read magnetometer (LSM303) data.
//  *
//  * \param[out]  data            Buffer to which magnetometer data is
//  *                              written into
//  * \param[out]   data_size      Size of magnetometer data in bytes
//  *
//  * \return Returns error code as specified in \ref psa_status_t
//  */
// psa_status_t example_read_lsm303(uint8_t *data,
//                                 size_t data_size);

/**
 * \brief Run secure inference to manipulate the sine value of input and
 *        encode and sign sine value using COSE CBOR
 *
 * \param[in]   key_id              EC key id which is used to access EC key
 *                                  to sign the payload after inference run
 * \param[in]   input               Angle in degrees
 * \param[out]  encoded_buf         Buffer to which encoded data
 *                                  is written into
 * \param[in]   encoded_buf_size    Size of encoded_buf in bytes
 * \param[out]  encoded_buf_len     Encoded and signed payload len in bytes
 *
 * \return Returns error code as specified in \ref psa_status_t
 */
psa_status_t psa_secure_inference_tflm_hello(psa_key_id_t *key_id,
					     const float *input,
					     size_t input_length,
					     uint8_t *encoded_buf,
					     size_t encoded_buf_size,
					     size_t *encoded_buf_len);

/**
 * \brief Export the public key from key derivation
 *
 * \param[in] key_id                   EC key id for persistent key
 * \param[in] ec_public_key_data       Buffer to which exported public key
 *                                     is written into
 * \param[in] ec_public_key_data_size  Size of ec_public_key_data in bytes
 *
 * \return Returns error code as specified in \ref psa_status_t
 */
psa_status_t psa_huk_key_derivation_export_public_key(psa_key_id_t *key_id,
						      uint8_t *ec_public_key_data,
						      size_t ec_public_key_data_size);

/**
 * \brief Generate UUID
 *
 * Generates an UUID based on
 * https://datatracker.ietf.org/doc/html/rfc4122#section-4.4
 *
 * \param[out] uuid          Buffer to write UUID
 * \param[in] uuid_size      Size of UUID buffer
 *
 * \return A status indicating the success/failure of the operation
 */
psa_status_t psa_huk_key_derivation_generate_uuid(void *uuid,
						  size_t uuid_size);

#ifdef __cplusplus
}
#endif

#endif /* __TFM_SECURE_INFER_PARTITIONS_SERVICE_API_H__ */
```

## src/tfm_tflm_service_api.c
```c
/*
 * Copyright (c) 2020, Arm Limited. All rights reserved.
 *
 * SPDX-License-Identifier: BSD-3-Clause
 *
 */

#include "tfm_tflm_service_api.h"

#include "psa/client.h"
#include "psa_manifest/sid.h"

// psa_status_t example_read_lsm303(uint8_t *data,
// 				 size_t data_size)
// {
// 	psa_status_t status;
// 	psa_handle_t handle;

// 	psa_outvec out_vec[] = {
// 		{ .base = data, .len = data_size },
// 	};

// 	handle = psa_connect(TFM_EXAMPLE_READ_LSM303_SID, TFM_EXAMPLE_READ_LSM303_VERSION);
// 	if (!PSA_HANDLE_IS_VALID(handle)) {
// 		return PSA_HANDLE_TO_ERROR(handle);
// 	}

// 	status = psa_call(handle, PSA_IPC_CALL, NULL, 0, out_vec, 1);

// 	psa_close(handle);

// 	return status;
// }

psa_status_t psa_secure_inference_tflm_hello(const float *input,
					     size_t input_length,
					     float *sine_value_buf,
					     size_t sine_value_buf_len)
{
	psa_status_t status;
	psa_handle_t handle;
	psa_invec in_vec[] = {
		{ .base = input, .len = input_length },
	};

	psa_outvec out_vec[] = {
		{ .base = sine_value_buf, .len = sine_value_buf_len },
	};

	handle = psa_connect(TFM_TFLM_SERVICE_HELLO_SID, TFM_TFLM_SERVICE_HELLO_VERSION);
	if (!PSA_HANDLE_IS_VALID(handle)) {
		return PSA_HANDLE_TO_ERROR(handle);
	}

	status = psa_call(handle, PSA_IPC_CALL, in_vec, 1, out_vec, 1);

	psa_close(handle);

	return status;
}
```

## src/tfm_tflm_service_api.h
```c
/*
 * Copyright (c) 2020, Arm Limited. All rights reserved.
 *
 * SPDX-License-Identifier: BSD-3-Clause
 *
 */

#ifndef __TFM_EXAMPLE_PARTITION_API_H__
#define __TFM_EXAMPLE_PARTITION_API_H__

#include <stdint.h>
#include <stddef.h>

#include "psa/error.h"

#ifdef __cplusplus
extern "C" {
#endif

// /**
//  * \brief Read magnetometer (LSM303) data.
//  *
//  * \param[out]  data            Buffer to which magnetometer data is
//  *                              written into
//  * \param[out]   data_size      Size of magnetometer data in bytes
//  *
//  * \return Returns error code as specified in \ref psa_status_t
//  */
// psa_status_t example_read_lsm303(uint8_t *data,
//                                 size_t data_size);

/**
 * \brief Run secure inference to get the sine value of input
 *
 * \param[in]   input               Angle in degrees
 * \param[in]   input_length        Length of input in bytes
 * \param[out]  sine_value_buf      Buffer to which calculated sine value
 *                                  is written into
 * \param[in]   sine_value_buf_len  Size of sine_value_buf in bytes
 *
 * \return Returns error code as specified in \ref psa_status_t
 */
psa_status_t psa_secure_inference_tflm_hello(const float *input,
					     size_t input_length,
					     float *sine_value_buf,
					     size_t sine_value_buf_len);

#ifdef __cplusplus
}
#endif

#endif /* __TFM_EXAMPLE_PARTITION_API_H__ */
```

## src/util_app_log.c
```c
/*
 * Copyright (c) 2021 Linaro Limited
 *
 * SPDX-License-Identifier: Apache-2.0
 */
#include <zephyr.h>
#include <logging/log_ctrl.h>
#include <logging/log.h>

#include "psa/crypto.h"
#include "util_app_log.h"

LOG_MODULE_REGISTER(app, CONFIG_LOG_DEFAULT_LEVEL);

psa_status_t al_psa_status(psa_status_t status, const char *func_name)
{
	switch (status) {
	case PSA_SUCCESS:
		break;

	/* Generic PSA errors (psa/error.h). */
	case PSA_ERROR_PROGRAMMER_ERROR:
		LOG_ERR("Programmer error");
		break;
	case PSA_ERROR_CONNECTION_REFUSED:
		LOG_ERR("Connection refused");
		break;
	case PSA_ERROR_CONNECTION_BUSY:
		LOG_ERR("Connection busy");
		break;
	case PSA_ERROR_GENERIC_ERROR:
		LOG_ERR("Generic error");
		break;
	case PSA_ERROR_NOT_PERMITTED:
		LOG_ERR("Not permitted");
		break;
	case PSA_ERROR_NOT_SUPPORTED:
		LOG_ERR("Unsupported operation");
		break;
	case PSA_ERROR_INVALID_ARGUMENT:
		LOG_ERR("Invalid argument");
		break;
	case PSA_ERROR_INVALID_HANDLE:
		LOG_ERR("Invalid handle");
		break;
	case PSA_ERROR_BAD_STATE:
		LOG_ERR("Bad state");
		break;
	case PSA_ERROR_BUFFER_TOO_SMALL:
		LOG_ERR("Buffer too small");
		break;
	case PSA_ERROR_ALREADY_EXISTS:
		LOG_ERR("Already exists");
		break;
	case PSA_ERROR_DOES_NOT_EXIST:
		LOG_ERR("Does not exist");
		break;
	case PSA_ERROR_INSUFFICIENT_MEMORY:
		LOG_ERR("Insufficient memory");
		break;
	case PSA_ERROR_INSUFFICIENT_STORAGE:
		LOG_ERR("Insufficient storage");
		break;
	case PSA_ERROR_INSUFFICIENT_DATA:
		LOG_ERR("Insufficient memory data");
		break;
	case PSA_ERROR_SERVICE_FAILURE:
		LOG_ERR("Service failure");
		break;
	case PSA_ERROR_COMMUNICATION_FAILURE:
		LOG_ERR("Communication failure");
		break;
	case PSA_ERROR_STORAGE_FAILURE:
		LOG_ERR("Storage failure");
		break;
	case PSA_ERROR_HARDWARE_FAILURE:
		LOG_ERR("Hardware failure");
		break;
	case PSA_ERROR_INVALID_SIGNATURE:
		LOG_ERR("Invalid signature");
		break;

	/* PSA crypto errors (psa/crypto_values.h). */
	case PSA_ERROR_INSUFFICIENT_ENTROPY:
		LOG_ERR("CRYPTO: Insufficient entropy");
		break;
	case PSA_ERROR_CORRUPTION_DETECTED:
		LOG_ERR("CRYPTO: Tampering detected");
		break;

	/* Catch-all error handler. */
	default:
		LOG_ERR("Unhandled status response: %d", status);
		break;
	}

	/* Display the calling function name for debug purposes. */
	if (status != PSA_SUCCESS) {
		LOG_ERR("Function: '%s'", func_name);
	}

	return status;
}

void al_dump_log(void)
{
	while (log_process(false)) {

	}
}
```

## src/util_app_log.h
```c
/*
 * Copyright (c) 2021 Linaro Limited
 *
 * SPDX-License-Identifier: Apache-2.0
 */

#include <stdarg.h>

#include "psa/error.h"
#include "psa/initial_attestation.h"
#include "psa/protected_storage.h"

#ifdef __cplusplus
extern "C" {
#endif

/**
 * @brief Logs PSA response messages other than PSA_SUCCESS for debugging
 *        purposes.
 *
 * @param status        The psa_status_t value to log.
 * @param func_name     The name of the function that made this function call.
 *
 * @return Returns the psa_status_t value passed into the function.
 */
psa_status_t al_psa_status(psa_status_t status, const char *func_name);

/**
 * @brief Calls 'log_process' in Zephyr to dump any queued log messages.
 */
void al_dump_log(void);

#ifdef __cplusplus
}
#endif
```

## src/util_sformat.c
```c
/*
 * Copyright (c) 2021 Linaro Limited
 *
 * SPDX-License-Identifier: Apache-2.0
 */

#include <ctype.h>
#include <stdio.h>
#include "util_sformat.h"

static void sf_hex_ascii(unsigned char *data, size_t len, unsigned char nonvis)
{
	uint32_t idx;

	/* Render printable characters. */
	idx = 0;
	while (len) {
		printf("%c", isprint(data[idx]) ? data[idx] : nonvis);
		idx++;
		len--;
	}
}

void sf_hex_tabulate_16(struct sf_hex_tbl_fmt *fmt, unsigned char *data,
			size_t len)
{
	uint32_t idx;
	uint32_t cpos;     /* Current position. */
	uint32_t ca;       /* Current address. */
	uint32_t ea;       /* End address. */

	if (!len) {
		return;
	}

	/* Set the end address (since we modify len in the write loop). */
	ea = fmt->addr + len;

	/* Check if we need to render the top address bar. */
	if (fmt->addr_label) {
		/* Render the top address bar. */
		printf("\n");
		printf("          ");
		printf("0  1  2  3  4  5  6  7  8  9  ");
		printf("A  B  C  D  E  F\n");
		printf("%08X ", fmt->addr - (fmt->addr % 16));
	}

	/* Insert offset padding for first row if necessary. */
	cpos = fmt->addr % 16;
	if (cpos != 0) {
		for (idx = 0; idx < cpos; idx++) {
			printf("   ");
		}
	}

	/* Print data row by row. */
	idx = 0;
	ca = fmt->addr;
	while (len) {
		/* Print the current value. */
		printf("%02X ", data[idx++]);
		cpos++;
		ca++;

		/* Wrap around to the next line if necessary. */
		if (cpos == 16 || ca == ea) {
			/* Render ASCII equiv at end of row if requested. */
			if (fmt->ascii) {
				if (ca == ea) {
					/* Handle last/single row. */
					if (ca % 16) {
						/* PARTIAL row (< 16 vals). */
						printf("%.*s",
						       (16 - ca % 16) * 3,
						       "                "
						       "                "
						       "                ");
						sf_hex_ascii(
							&data[idx - (ca % 16)],
							ca - fmt->addr < 16 ?
							idx % 16 : ca % 16,
							'.');
					} else {
						/* FULL row. */
						sf_hex_ascii(
							&data[idx - 16],
							16, '.');
					}
				} else if (ca < fmt->addr + 15) {
					/* Handle first row. */
					printf("%.*s", fmt->addr % 16,
					       "                ");
					sf_hex_ascii(data,
						     16 - fmt->addr % 16, '.');
				} else {
					/* Full row. */
					sf_hex_ascii(&data[idx - 16], 16, '.');
				}
			}

			/* Wrap around if this isn't the last row. */
			printf("\n");
			if (ca != ea) {
				/* Render the next base row addr. */
				if (fmt->addr_label) {
					printf("%08X ", ca);
				}
			}
			cpos = 0;
		}
		len--;
	}
	printf("\n");
}
```

## src/util_sformat.h
```c
/*
 * Copyright (c) 2021 Linaro Limited
 *
 * SPDX-License-Identifier: Apache-2.0
 */

#ifndef _SFORMAT_H_
#define _SFORMAT_H_

#include <stdint.h>
#include <zephyr.h>

#ifdef __cplusplus
extern "C" {
#endif

/**
 * @brief Indicates how hex data should be rendered in tabular format.
 */
struct sf_hex_tbl_fmt {
	/** Whether or not to render ASCII equivalents. */
	uint8_t ascii : 1;
	/** Whether or not to add address labels to the output. */
	uint8_t addr_label : 1;
	/** The starting value for the address labels. */
	uint32_t addr;
} __packed;

/**
 * @brief Prints a 16-value wide tabular rendering of 8-bit hex data, with
 *        optional ascii equivalents and address labels.
 *
 * @param fmt   Pointer to thee sf_hex_tbl_fmt struct indicating how the
 *              table should be rendered.
 * @param data  Pointer to the data to render.
 * @param len   The number of bytes to render from data.
 */
void sf_hex_tabulate_16(struct sf_hex_tbl_fmt *fmt, unsigned char *data,
			size_t len);

#ifdef __cplusplus
}
#endif

#endif /* _SFORMAT_H_ */
```
